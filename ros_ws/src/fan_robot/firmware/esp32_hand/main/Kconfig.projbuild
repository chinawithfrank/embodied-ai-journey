## ros_ws/src/fan_robot/firmware/esp32_hand/main/Kconfig.projbuild
```kconfig
menu "Fan robot: offline hand detector"

config FAN_ENABLE_PREVIEW
    bool "Enable optional local Wi-Fi AP and browser preview"
    default y

config FAN_HAND_SCORE_PERCENT
    int "Minimum hand confidence (percent)"
    range 1 99
    default 50

config FAN_HAND_INTERVAL_MS
    int "Minimum capture cycle interval (milliseconds)"
    range 100 5000
    default 400

config FAN_ENABLE_AUTONOMY
    bool "Enable local hand-follow controller (requires calibrated local settings)"
    depends on FAN_ENABLE_PREVIEW
    default n
    help
        Adds /robot arming UI, a 20ms output supervisor, and bounded track pulses.
        Starts disarmed. Requires confirmed motor/fan wiring and autonomy settings.

endmenu
```

## ros_ws/src/fan_robot/firmware/esp32_hand/sdkconfig.defaults
```kconfig
CONFIG_IDF_TARGET="esp32s3"
CONFIG_ESPTOOLPY_FLASHSIZE_16MB=y
CONFIG_ESPTOOLPY_FLASHMODE_QIO=y
CONFIG_ESPTOOLPY_FLASHFREQ_80M=y
CONFIG_SPIRAM=y
CONFIG_SPIRAM_MODE_OCT=y
CONFIG_SPIRAM_SPEED_80M=y
CONFIG_SPIRAM_USE_MALLOC=y
CONFIG_SPIRAM_MALLOC_ALWAYSINTERNAL=16384
CONFIG_SPIRAM_MALLOC_RESERVE_INTERNAL=65536
CONFIG_ESP_DEFAULT_CPU_FREQ_MHZ_240=y
CONFIG_ESP32S3_DATA_CACHE_64KB=y
CONFIG_ESP32S3_DATA_CACHE_LINE_64B=y
CONFIG_ESP_CONSOLE_USB_SERIAL_JTAG=y
CONFIG_PARTITION_TABLE_CUSTOM=y
CONFIG_PARTITION_TABLE_CUSTOM_FILENAME="partitions.csv"
CONFIG_ESP_MAIN_TASK_STACK_SIZE=16384
CONFIG_COMPILER_OPTIMIZATION_PERF=y
CONFIG_FLASH_ESPDET_PICO_224_224_HAND=y
CONFIG_ESPDET_PICO_224_224_HAND=y
CONFIG_HAND_DETECT_MODEL_IN_FLASH_RODATA=y
CONFIG_FAN_ENABLE_PREVIEW=y
CONFIG_FAN_HAND_SCORE_PERCENT=50
CONFIG_FAN_HAND_INTERVAL_MS=400
```
