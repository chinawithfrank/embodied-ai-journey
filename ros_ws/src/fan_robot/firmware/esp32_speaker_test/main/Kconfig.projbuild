## ros_ws/src/fan_robot/firmware/esp32_speaker_test/main/Kconfig.projbuild
```kconfig
menu "Fan robot audio bench test"
config FAN_TEST_MICROPHONE
    bool "Measure microphone level instead of playing the speaker tone"
    default n
endmenu
```
